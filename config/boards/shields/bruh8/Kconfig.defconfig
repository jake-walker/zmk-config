## config/boards/shields/bruh8/Kconfig.defconfig
```kconfig
if SHEILD_BRUH8

config ZMK_KEYBOARD_NAME
  default "bruh8"

endif

if ZMK_BACKLIGHT

config PWM
  default y

config LED_PWM
  default Y

endif
```
